## config/boards/shields/xiao/Kconfig.defconfig
```kconfig
# Copyright (c) 2022 The ZMK Contributors
# SPDX-License-Identifier: MIT

if SHIELD_XIAO_RIGHT

config ZMK_KEYBOARD_NAME
    default "Apsis"
    
config ZMK_SPLIT_ROLE_CENTRAL
    default y

endif

if SHIELD_XIAO_LEFT || SHIELD_XIAO_RIGHT

config ZMK_SPLIT
    default y

endif
```

## config/boards/shields/xiao/Kconfig.shield
```kconfig
# Copyright (c) 2022 The ZMK Contributors
# SPDX-License-Identifier: MIT

config SHIELD_XIAO_LEFT
    def_bool $(shields_list_contains,xiao_left)

config SHIELD_XIAO_RIGHT
    def_bool $(shields_list_contains,xiao_right)
```

## config/boards/shields/xiao2/Kconfig.defconfig
```kconfig
# Copyright (c) 2022 The ZMK Contributors
# SPDX-License-Identifier: MIT

if SHIELD_XIAO2_LEFT

config ZMK_KEYBOARD_NAME
    default "Apsis"
    
config ZMK_SPLIT_ROLE_CENTRAL
    default n

endif

if SHIELD_XIAO2_LEFT || SHIELD_XIAO2_RIGHT

config ZMK_SPLIT
    default y

endif
```

## config/boards/shields/xiao2/Kconfig.shield
```kconfig
# Copyright (c) 2022 The ZMK Contributors
# SPDX-License-Identifier: MIT

config SHIELD_XIAO2_LEFT
    def_bool $(shields_list_contains,xiao2_left)

config SHIELD_XIAO2_RIGHT
    def_bool $(shields_list_contains,xiao2_right)
```
